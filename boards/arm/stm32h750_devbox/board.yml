## boards/arm/stm32h750_devbox/board.yml
```yaml
board:
  name: stm32h750_devbox
  full_name: STM32H750VBT6 Dev Box
  vendor: custom
  socs:
    - name: stm32h750xx
```

## boards/arm/stm32h750_devbox/stm32h750_devbox_defconfig
```kconfig
# SPDX-License-Identifier: Apache-2.0

# Enable MPU
CONFIG_ARM_MPU=y

# Enable HW stack protection
CONFIG_HW_STACK_PROTECTION=y

CONFIG_SERIAL=y

# console
CONFIG_CONSOLE=y
CONFIG_UART_CONSOLE=y

# enable GPIO
CONFIG_GPIO=y

# Enable Clocks
CONFIG_CLOCK_CONTROL=y

# Enable USB console
CONFIG_USB_DEVICE_STACK=y
CONFIG_USB_DEVICE_INITIALIZE_AT_BOOT=y
CONFIG_UART_LINE_CTRL=y
```

## boards/xtensa/esp32s3_n16r8_devbox/board.yml
```yaml
board:
  name: esp32s3_n16r8_devbox
  full_name: ESP32-S3 N16R8 Dev Box
  vendor: custom
  socs:
    - name: esp32s3
```
